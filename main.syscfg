/**
 * These arguments were used when this file was generated. They will be automatically applied on subsequent loads
 * via the GUI or CLI. Run CLI with '--help' for additional information on how to override these arguments.
 * @cliArgs --board "/ti/boards/CC3220S_LAUNCHXL" --product "simplelink_cc32xx_sdk@5.10.00.02"
 * @versions {"data":"2021031521","timestamp":"2021031521","tool":"1.8.0+1863","templates":null}
 */

/**
 * Import the modules used in this configuration.
 */
const ADC   = scripting.addModule("/ti/drivers/ADC", {}, false);
const ADC1  = ADC.addInstance();
const ADC2  = ADC.addInstance();
const ADC3  = ADC.addInstance();
const I2C   = scripting.addModule("/ti/drivers/I2C", {}, false);
const I2C1  = I2C.addInstance();
const PWM   = scripting.addModule("/ti/drivers/PWM", {}, false);
const PWM1  = PWM.addInstance();
const RTOS  = scripting.addModule("/ti/drivers/RTOS");
const UART  = scripting.addModule("/ti/drivers/UART");
const UART1 = UART.addInstance();

/**
 * Write custom configuration values to the imported modules.
 */
ADC1.$name     = "CONFIG_ADC_0";
ADC1.$hardware = system.deviceData.board.components.OPA4342.subComponents.AIN4;

ADC2.$name     = "CONFIG_ADC_1";
ADC2.$hardware = system.deviceData.board.components.OPA4342.subComponents.AIN3;

ADC3.$name     = "CONFIG_ADC_2";
ADC3.$hardware = system.deviceData.board.components.OPA4342.subComponents.AIN2;

I2C1.$name              = "CONFIG_I2C_0";
I2C1.i2c.sdaPin.$assign = "boosterpack.14";
I2C1.i2c.sclPin.$assign = "boosterpack.7";

PWM1.$name                = "CONFIG_PWM_0";
PWM1.$hardware            = system.deviceData.board.components.LED_YELLOW;
PWM1.timer.pwmPin.$assign = "boosterpack.9";

const Power          = scripting.addModule("/ti/drivers/Power", {}, false);
Power.parkPins.$name = "ti_drivers_power_PowerCC32XXPins0";

RTOS.name = "NoRTOS";

UART1.$name     = "CONFIG_UART_0";
UART1.$hardware = system.deviceData.board.components.XDS110UART;

/**
 * Pinmux solution for unlocked pins/peripherals. This ensures that minor changes to the automatic solver in a future
 * version of the tool will not impact the pinmux you originally saw.  These lines can be completely deleted in order to
 * re-solve from scratch.
 */
ADC1.adc.$suggestSolution         = "ADC0";
ADC1.adc.adcPin.$suggestSolution  = "boosterpack.24";
ADC2.adc.$suggestSolution         = "ADC0";
ADC2.adc.adcPin.$suggestSolution  = "boosterpack.26";
ADC3.adc.$suggestSolution         = "ADC0";
ADC3.adc.adcPin.$suggestSolution  = "boosterpack.2";
I2C1.i2c.$suggestSolution         = "I2C0";
PWM1.timer.$suggestSolution       = "Timer3";
UART1.uart.$suggestSolution       = "UART0";
UART1.uart.txPin.$suggestSolution = "55";
UART1.uart.rxPin.$suggestSolution = "57";
